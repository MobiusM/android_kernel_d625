## arch/arm/mach-tegra/lge/Kconfig
```kconfig
config MACH_LGE
        bool

menu "LGE Device-Specific Changes"

menu "LGE Board Selection"

choice
        prompt "LGE Board selection"
        default MACH_PDA

config MACH_PDA
       bool "PDA board"
       depends on ARCH_TEGRA_14x_SOC
       select MACH_LGE
       select MACH_HAS_SND_SOC_TEGRA_MAX98090 if SND_SOC
       select MACH_HAS_SND_SOC_TEGRA_TLV320AIC325X if SND_SOC
       select MACH_HAS_SND_SOC_TEGRA_DMIC_REV1 if SND_SOC

       help
         Support for LGE PDA Development platform

endchoice

config LGE_MODEM_CRASH_HANDLER
       bool "LGE modem crash handler support"
       default n
       help
         Support LGE Modem crash handler

endmenu

config LGE_HIDDEN_RESET
       bool "LGE hidden Reset support"
       default n
       help
         Support LGE Hidden Reset

config LGE_BOOTLOADER_LOG_BUFFER
       bool "LGE Bootloader log buffer"
       default n
       help
         Say Y here to enable see bootloader debugging messages in Kernel message.

config LGE_HANDLE_PANIC_CP15
       bool "LGE handle panic using CP15 register"
       default n
       help
         Support LGE handle panic using CP15 register

config LGE_BLUETOOTH
       bool "LGE bluetooth driver"
       default n
       help
         Support LGE Bluetooth Power & Sleep

endmenu
```

## drivers/input/sensors/Kconfig
```kconfig
menuconfig INPUT_SENSOR
	bool "Sensors"
	help
	  Say Y here, and a list of supported touchscreens will be displayed.
	  This option doesn't affect the kernel.

	  If unsure, say Y.

if INPUT_SENSOR

config SENSORS_BMC150_COMMON
	bool
	default n

config SENSORS_BMA2X2
	tristate "BMA255/BMA250E/BMA222E/BMA280 acceleration sensor support"
	depends on I2C=y
	select SENSORS_BMC150_COMMON
	help
	  If you say yes here you get support for Bosch Sensortec's
	  acceleration sensors BMA255/BMA250E/BMA222E/BMA280.

config SENSORS_BMM050
	tristate "BMM050 Magnetic Sensor Driver"
	depends on I2C=y
	select SENSORS_BMC150_COMMON
	help
	 BMM050 Magnetic Sensor Driver implemented by Bosch-Sensortec.

config SENSORS_APDS9130
	tristate "APDS9130 Proximity Sensor Driver"
	depends on I2C=y
	select SENSORS_BMC150_COMMON
	help
	 APDS9130 Proximity Sensor Driver implemented by Avago Tech.

endif
```

## drivers/switch/Kconfig
```kconfig
menuconfig SWITCH
	tristate "Switch class support"
	help
	  Say Y here to enable switch class support. This allows
	  monitoring switches by userspace via sysfs and uevent.

if SWITCH

config SWITCH_GPIO
	tristate "GPIO Swith support"
	depends on GENERIC_GPIO
	help
	  Say Y here to enable GPIO based switch support.

config SWITCH_MAX1462X
	tristate "LGE Headset detection driver(MAX14628)"
	default n
	help
	  Say Y here to enable GPIO based switch support.

config SWITCH_MAX14688
	tristate "MAXIM MAX14688 headset jack detector support"
	depends on I2C
	default n
	help
	  This option enables device driver support for MAX14688, a headset jack detection IC.
	  To compile this driver as module, choose M here: the

config SWITCH_3BUTTON_EARJACK
	bool "LGE Headset support 3-button earjack"
	default n
	help
	  Say Y hear to support 3-button earjack

endif # SWITCH
```
